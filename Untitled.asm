LIST P=16F877 
 INCLUDE <P16F877.INC> 
#INCLUDE<LCDCONFIGURATION.INC>
DELAY MACRO VAL
LOCAL LABL
BANKSEL OPTION_REG
MOVLW VAL
MOVWF OPTION_REG
BANKSEL TMR0
CLRF TMR0
BCF INTCON,T0IF
LABL:
BTFSS INTCON,T0IF
GOTO LABL
ENDM
 FLAGS EQU 0x20 
 ADC_DATA EQU 0x21 
 DATA_READY EQU 0X00
 ORG 0x00 
 GOTO ITR 
 ORG 0x08 
 GOTO INT_S 
 ITR
 CLRF PORTD
 CLRF PORTC 
 BANKSEL TRISC
CLRF TRISD
CLRF TRISC 
MOVLW 0x0E 
 MOVWF ADCON1 
 BSF TRISA,0 
 BANKSEL PORTB
 MOVLW 0x41  
 MOVWF ADCON0 
BSF ADCON0,GO
 BCF FLAGS,DATA_READY
 BSF ADCON0,GO
 CMD 0x38
 CMD 0x06
 CMD 0x0C
 CMD 0x83
 DTR 'W'
 DTR 'E'
 DTR 'L'
 DTR 'C'
 DTR 'O'
 DTR 'M'
 DTR 'E'
 DELAY 0x87
MAIN 
CLRWDT
 BTFSS ADCON0,GO 
 GOTO INT_S
 BCF FLAGS,DATA_READY 
 MOVF ADC_DATA,W 
  SUBLW 0x02
 BTFSC STATUS,Z
 GOTO LABEL1
MOVF ADC_DATA,W
SUBLW 0X2A
BTFSC STATUS,Z
GOTO LABEL2
  MOVF ADC_DATA,W
 SUBLW 0x7F
 BTFSC STATUS,Z
 GOTO LABEL3
  MOVF ADC_DATA,W
 SUBLW 0xF3
 BTFSC STATUS,Z
 GOTO LABEL4
GOTO MAIN  
LABEL1
CMD 0X01
CMD 0X80
CLRF PORTC
BSF PORTC,4
BSF PORTC,5
BSF PORTC,6
 DTR 'L'
 DTR 'O'
 DTR 'W'
 DTR ' '
 DTR 'L'
 DTR 'I'
 DTR 'G'
 DTR 'H'
 DTR 'T'

DELAY 0X87
GOTO MAIN
LABEL2
CMD 0X01
CLRF PORTC
BSF PORTC,5
BSF PORTC,6
 DTR 'N'
 DTR 'O'
 DTR 'R'
 DTR 'M'
 DTR 'A'
 DTR 'L'
 DTR ' '
 DTR 'L'
 DTR 'I'
 DTR 'G'
 DTR 'H'
 DTR 'T'
DELAY 0X87
GOTO MAIN
LABEL3
CMD 0X01
CLRF PORTC
BSF PORTC,6
 DTR 'H'
DTR 'I'
 DTR 'G'
 DTR 'H'
 DTR ' '
 DTR 'L'
DTR 'I'
 DTR 'G'
 DTR 'H'
 DTR 'T'
DELAY 0X87
GOTO MAIN
LABEL4
CMD 0X01
CLRF PORTC
DTR 'T'
DTR 'O'
DTR 'O'
DTR ' '
DTR 'H'
DTR 'I'
DTR 'G'
DTR 'H'
DTR ' '
DTR 'L'
DTR 'I'
 DTR 'G'
 DTR 'H'
 DTR 'T'
DELAY 0X87
GOTO MAIN
 INT_S
 MOVF ADRESH,W 
MOVWF ADC_DATA 
MOVF ADC_DATA,W 
MOVWF PORTD
 BCF PIR1,ADIF 
 BSF FLAGS,DATA_READY 
 BSF ADCON0,GO 
 GOTO MAIN 
 END


